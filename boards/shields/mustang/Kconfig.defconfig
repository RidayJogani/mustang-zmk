## boards/shields/mustang/Kconfig.defconfig
```kconfig
if SHIELD_MUSTANG_LEFT

config ZMK_KEYBOARD_NAME
    default "mustang"

config ZMK_SPLIT_ROLE_CENTRAL
    default y

config ZMK_SPLIT_BLE_CENTRAL_BATTERY_LEVEL_FETCHING
    default y

config ZMK_SPLIT_BLE_CENTRAL_BATTERY_LEVEL_PROXY
    default y

endif

if SHIELD_MUSTANG_LEFT || SHIELD_MUSTANG_RIGHT

config ZMK_SPLIT
    default y

endif
```

## boards/shields/mustang/Kconfig.shield
```kconfig
config SHIELD_MUSTANG_LEFT
    def_bool $(shields_list_contains,mustang_left)

config SHIELD_MUSTANG_RIGHT
    def_bool $(shields_list_contains,mustang_right)
```
